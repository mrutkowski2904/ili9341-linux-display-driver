&spi0 {
	status = "okay";
    pinctrl-names = "default";
    pinctrl-0 = <&spi0_pins>;

    ili9341: ili9341@0 {
		compatible = "mr,custom_ili9341";
		reg = <0x0>;
		spi-max-frequency = <50000000>;
		spi-bits-per-word = <8>;
		status = "okay";
		dc-gpios = <&gpio2 2 GPIO_ACTIVE_HIGH>;
	};
};

&am33xx_pinmux {
	spi0_pins: spi0_pins {
		pinctrl-single,pins = <
			0x150 (PIN_OUTPUT_PULLUP | MUX_MODE0)
			0x154 (PIN_INPUT_PULLUP | MUX_MODE0)
			0x158 (PIN_INPUT_PULLUP | MUX_MODE0)
			0x15C (PIN_OUTPUT_PULLUP | MUX_MODE0)
		>;
	};
};