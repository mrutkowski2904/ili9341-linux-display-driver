/dts-v1/;
/plugin/;
/ {
	/* Raspberry Pi 3 */
	compatible = "brcm,bcm2837";

	fragment@0 {
		target = <&spidev0>;
		__overlay__ {
			status = "disabled";
		};
	};
	
	fragment@2 {
		target = <&spi0>;
		__overlay__ {
			status = "okay";
			#address-cells = <1>;
			#size-cells = <0>;

			ili9341: ili9341@0 {
				compatible = "mr,custom_ili9341";
				reg = <0x0>;
				spi-max-frequency = <50000000>;
				spi-bits-per-word = <8>;
				status = "okay";
				dc-gpios = <&gpio 25 0>;
			};
		};
	};
};
